// SPDX-License-Identifier: GPL-2.0-only
/*
 * Device Tree overlay for the custom STM32 acquisition peripheral
 * (v1-spi-slave-handshake firmware) on Raspberry Pi 5 (spi0, CS0).
 *
 * Disables the stock `spidev0` binding on spi0 CS0 and replaces it with a
 * node the custom-acq kernel driver (driver/custom-acq/) can bind to via
 * its "edp,custom-acq" compatible string.
 *
 * Build:   dtc -@ -I dts -O dtb -o custom-acq.dtbo custom-acq-overlay.dts
 * Install: copy custom-acq.dtbo to /boot/firmware/overlays/, add
 *          "dtoverlay=custom-acq" to /boot/firmware/config.txt, reboot.
 */

/dts-v1/;
/plugin/;

/ {
	compatible = "brcm,bcm2712";

	fragment@0 {
		target = <&spidev0>;
		__overlay__ {
			status = "disabled";
		};
	};

	fragment@1 {
		target = <&spi0>;
		__overlay__ {
			#address-cells = <1>;
			#size-cells = <0>;
			status = "okay";

			custom_acq: custom-acq@0 {
				compatible = "edp,custom-acq";
				reg = <0>;
				spi-max-frequency = <1000000>;
				status = "okay";

				/* DATA_READY: MCU PA8 -> Pi GPIO17 (physical
				 * pin 11). Active-high level signal, not a
				 * bus protocol pin, so any free GPIO works
				 * (see docs/debugging/case-03-...-verification.md
				 * for why GPIO17 specifically). The driver
				 * reads this via gpiod + gpiod_to_irq(),
				 * not the standard "interrupts" property, so
				 * it doesn't depend on the GPIO controller
				 * being wired up as an interrupt-parent in
				 * this overlay.
				 */
				/* 3rd cell 0 = GPIO_ACTIVE_HIGH. Not using the
				 * <dt-bindings/gpio/gpio.h> macro here since
				 * our plain `dtc` build command doesn't run
				 * the C preprocessor first.
				 */
				data-ready-gpios = <&gpio 17 0>;

				/* V7: optional marker pin, Pi GPIO27
				 * (physical pin 13) - toggled by the driver
				 * in custom_acq_irq_hard() so a logic
				 * analyzer can capture it alongside the
				 * MCU's own PA9 sample-produced marker
				 * (v1-spi-slave-handshake/v1.3), both on the
				 * analyzer's single clock. Free pin, not
				 * used by SPI0 (GPIO7-11) or DATA_READY
				 * (GPIO17). Optional in the driver (gpiod_get_optional)
				 * so this property can be omitted with no
				 * effect on normal operation. */
				irq-marker-gpios = <&gpio 27 0>;
			};
		};
	};
};
